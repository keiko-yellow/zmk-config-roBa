## Kconfig
```kconfig
menu "roBa custom automouse"

config ROBA_AUTOMOUSE_TYPING_GUARD_MS
    int "Automouse activation delay after normal key press (ms)"
    default 500
    range 0 2000
    help
      Pointer movement is still reported during this period, but movement
      cannot activate the automouse layer. Each normal key press restarts
      the period. Mouse-button positions do not restart it while the
      automouse layer is already active.

endmenu
```

## config/west.yml
```yaml
manifest:
  remotes:
    - name: zmkfirmware
      url-base: https://github.com/zmkfirmware

  projects:
    - name: zmk
      remote: zmkfirmware

      # main追従をやめ、同じ内容で再ビルドできるよう固定する。
      revision: 484a0547078228f6957ed164523823e39fbedec4

      import: app/west.yml

  self:
    path: config
```

## dts/bindings/input/zmk,input-processor-motion-threshold.yaml
```yaml
description: Gate relative pointer movement until a cumulative threshold is reached

compatible: "zmk,input-processor-motion-threshold"

include: base.yaml

properties:
  "#input-processor-cells":
    type: int
    required: true
    const: 1

  track-remainders:
    type: boolean

  threshold:
    type: int
    required: true
    description: Cumulative absolute X and Y movement required before an event is passed

  reset-timeout-ms:
    type: int
    default: 200
    description: Idle period after which accumulated movement is reset

input-processor-cells:
  - layer
```
